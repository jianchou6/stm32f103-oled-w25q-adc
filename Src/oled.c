#include "oled.h"
#define OLED_ADDR 0x78
#include <stdio.h>
/*OLED字模库，宽8像素，高16像素*/
const uint8_t F8X16[]=
{
	0x00,0x00,0x00,0x00,0x00,0x00,0x00,0x00,
	0x00,0x00,0x00,0x00,0x00,0x00,0x00,0x00,//  0

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	0x00,0x00,0x00,0x00,0x00,0x00,0x00,0x00,//~ 94
};


void I2C_Delay_us(uint16_t t)
{
	uint16_t i,j;
	for(i=0;i<t;i++)
		for(j=0;j<72;j++);
}

// 发送1字节，返回ACK：0=收到应答，1=无应答
uint8_t I2C_WriteByte(uint8_t dat)
{
	uint8_t i,ack;
	for(i=0;i<8;i++)
	{
		SCL_L;
		if(dat & 0x80) SDA_H;
		else SDA_L;
		dat <<= 1;
		I2C_Delay_us(2);
		SCL_H;
		I2C_Delay_us(2);
	}
	SCL_L;
	SDA_H; // 释放SDA，等待从机ACK
	I2C_Delay_us(2);
	SCL_H;
	ack = SDA_R; // 读取ACK，低电平=ACK成功
	SCL_L;
	return ack;
}

//起始
void I2C_Start(void)
{
	SDA_H;
	SCL_H;
	I2C_Delay_us(5);
	SDA_L;
	I2C_Delay_us(5);
	SCL_L;
}

void I2C_Stop(void)
{
	SDA_L;
	SCL_H;
	I2C_Delay_us(5);
	SDA_H;
	I2C_Delay_us(5);
}

//写数据
void OLED_Write_Data(uint8_t data)
{
    I2C_Start();
    I2C_WriteByte(OLED_ADDR);    //从机地址
    I2C_WriteByte(0x40);         //0x40：后续字节为【数据】
    // 重点：字模数据在这里做位反转！！
    I2C_WriteByte(data );
    I2C_Stop();
}

//写命令，保持原样，不要ReverseBit！！
void OLED_Write_Cmd(uint8_t cmd)
{
    I2C_Start();
    I2C_WriteByte(OLED_ADDR);
    I2C_WriteByte(0x00);        //0x00：后续字节为【命令】
    I2C_WriteByte(cmd);
    I2C_Stop();
}



//设置坐标 x:0~127，y:0~7(页)
void OLED_Set_Pos(uint8_t x, uint8_t y)
{
    OLED_Write_Cmd(0xb0 + y);

    OLED_Write_Cmd(((x & 0xf0) >> 4) | 0x10);
    OLED_Write_Cmd(x & 0x0f);
}

//清屏
void OLED_Clear(void)
{
	uint8_t y,x;
	for(y=0;y<8;y++)
	{
		OLED_Write_Cmd(0xB0+y);
		OLED_Write_Cmd(0x00);
		OLED_Write_Cmd(0x10);
		for(x=0;x<128;x++)
		{
			OLED_Write_Data(0x00);
		}
	}
}
// SSD1306 初始化序列（0.96寸 128*64）
void OLED_Init(void)
{
	I2C_Stop();
	HAL_Delay(100);
	OLED_Write_Cmd(0xAE); //关闭显示
	OLED_Write_Cmd(0xD5); //设置时钟分频因子,震荡频率
	OLED_Write_Cmd(0x80);
	OLED_Write_Cmd(0xA8); //设置驱动路数
	OLED_Write_Cmd(0x3F);
	OLED_Write_Cmd(0xD3); //显示偏移
	OLED_Write_Cmd(0x00);
	OLED_Write_Cmd(0x40); //设置显示开始行
	OLED_Write_Cmd(0xA1); //左右反向（A0/A1根据屏幕调换）
	OLED_Write_Cmd(0xC8); //上下反向（C0/C8根据屏幕调换）
	OLED_Write_Cmd(0xDA); //COM硬件配置
	OLED_Write_Cmd(0x12);
	OLED_Write_Cmd(0x81); //对比度设置
	OLED_Write_Cmd(0xCF);
	OLED_Write_Cmd(0xD9); //预充电周期
	OLED_Write_Cmd(0xF1);
	OLED_Write_Cmd(0xDB); //VCOMH取消选择级别
	OLED_Write_Cmd(0x30);
	OLED_Write_Cmd(0xA4); //全局显示开启
	OLED_Write_Cmd(0xA6); //正常显示(A7反白)
	OLED_Write_Cmd(0x8D); //电荷泵使能！！这个黑屏最常见原因
	OLED_Write_Cmd(0x14); //开启电荷泵！0x10关闭，屏幕不供电黑屏
	OLED_Write_Cmd(0xAF); //开启显示
	OLED_Clear();
}



//显示数字 8*16字库修复版本
// 显示一个字符（8×16 字库）
void OLED_ShowChar(uint8_t x, uint8_t y, char ch)
{
    uint8_t i;
    uint8_t c;

    if(ch < ' ' || ch > '~') return;   // 只支持可打印字符
    c = ch - ' ';                       // 转成字库序号（0~94）


        // 上半页：8 个字节
        OLED_Set_Pos(x, y);
        for(i = 0; i < 8; i++)
        {
            OLED_Write_Data(F8X16[c * 16 + i]);
        }
        // 下半页：8 个字节
        OLED_Set_Pos(x, y + 1);
        for(i = 0; i < 8; i++)
        {
            OLED_Write_Data(F8X16[c * 16 + 8 + i]);
        }

}
// 显示数字（额外函数，与 OLED_ShowChar 区分开）
void OLED_ShowNum(uint8_t x, uint8_t y, uint32_t num, uint8_t len)
{
    uint8_t t, temp;
    uint8_t enshow = 0;
    uint32_t divisor = 1;

    for(t = 0; t < len - 1; t++) divisor *= 10;

    for(t = 0; t < len; t++)
    {
        temp = num / divisor;
        num = num % divisor;
        divisor /= 10;

        if(enshow == 0 && t < (len - 1))
        {
            if(temp == 0)
            {
                OLED_Set_Pos(x, y);
                for(uint8_t i = 0; i < 8; i++) OLED_Write_Data(0x00);

                OLED_Set_Pos(x, y + 1);
                for(uint8_t i = 0; i < 8; i++) OLED_Write_Data(0x00);

                x += 8;
                continue;
            }
            else enshow = 1;
        }

        OLED_ShowChar(x, y, temp + '0');   // 调用 OLED_ShowChar
        x += 8;
    }
}
// 显示字符串
void OLED_ShowString(uint8_t x, uint8_t y, char *str)
{

    while(*str != '\0')
    {
    	if(x>120 || y>6)break;
    	OLED_ShowChar(x, y, *str);
        x += 8;                          // 每个字符占 8 列
        if(x > 120)                      // 换行
        {
            x = 0;
            y += 2;                      // 8×16 字体占 2 页
        }
        str++;
    }
}


